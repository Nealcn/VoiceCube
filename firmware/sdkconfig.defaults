## firmware/sdkconfig.defaults
```kconfig
# M5AtomS3 Voice Stick - ESP-IDF Configuration Defaults
# Target: ESP32-S3

# ---- Chip & Clocks ----
CONFIG_IDF_TARGET="esp32s3"
CONFIG_ESP_DEFAULT_CPU_FREQ_MHZ_240=y
CONFIG_ESP_DEFAULT_CPU_FREQ_MHZ=240
CONFIG_XTAL_FREQ_40=y
CONFIG_XTAL_FREQ=40

# ---- PSRAM (8MB OPI) ----
CONFIG_SPIRAM=y
CONFIG_SPIRAM_MODE_OCT=y
CONFIG_SPIRAM_TYPE_AUTO=y
CONFIG_SPIRAM_ALLOW_BSS_SEG_EXTERNAL_MEMORY=y
CONFIG_SPIRAM_MALLOC_ALWAYSINTERNAL=4096
CONFIG_SPIRAM_TRY_ALLOCATE_WIFI_LWIP=y
CONFIG_SPIRAM_MALLOC_RESERVE_INTERNAL=32768

# ---- Bluetooth / BLE (NimBLE) ----
CONFIG_BT_ENABLED=y
CONFIG_BT_NIMBLE_ENABLED=y
CONFIG_BT_BLUEDROID_ENABLED=n
CONFIG_BT_CONTROLLER_ENABLED=y
CONFIG_BT_NIMBLE_MEM_ALLOC_MODE_INTERNAL=y
CONFIG_BT_NIMBLE_LEGACY_VHCI_ENABLE=y
CONFIG_BT_NIMBLE_MAX_CONNECTIONS=1
CONFIG_BT_NIMBLE_ROLE_PERIPHERAL=y
CONFIG_BT_NIMBLE_GATT_SERVER=y
CONFIG_BT_NIMBLE_SVC_GAP_DEVICE_NAME=""
CONFIG_BT_NIMBLE_LOG_LEVEL_WARNING=y
CONFIG_BT_NIMBLE_ATT_PREFERRED_MTU=247
CONFIG_BT_NIMBLE_MSYS_1_BLOCK_COUNT=100
CONFIG_BT_NIMBLE_MSYS_1_BLOCK_SIZE=256
CONFIG_BT_NIMBLE_MSYS_2_BLOCK_COUNT=0

# ---- FreeRTOS ----
CONFIG_FREERTOS_HZ=100

# ---- Logging ----
CONFIG_LOG_DEFAULT_LEVEL_INFO=y
CONFIG_LOG_DEFAULT_LEVEL=3
CONFIG_LOG_TIMESTAMP_SOURCE_RTOS=y

# ---- Partition Table ----
CONFIG_PARTITION_TABLE_CUSTOM=y
CONFIG_PARTITION_TABLE_CUSTOM_FILENAME="partitions.csv"

# ---- Compiler Optimization ----
CONFIG_COMPILER_OPTIMIZATION_SIZE=y

# ---- Flash ----
CONFIG_ESPTOOLPY_FLASHSIZE_8MB=y
CONFIG_ESPTOOLPY_FLASHSIZE=8MB
CONFIG_ESPTOOLPY_FLASHMODE_QIO=y
CONFIG_ESPTOOLPY_FLASHFREQ_80M=y

# ---- Sleep ----
CONFIG_PM_ENABLE=y
CONFIG_PM_POWER_DOWN_CPU_IN_LIGHT_SLEEP=y

# ---- Task/Interrupt WDT ----
CONFIG_ESP_TASK_WDT_TIMEOUT_S=30
CONFIG_ESP_TASK_WDT_INIT=n
CONFIG_ESP_INT_WDT=n

# ---- Stack sizes ----
CONFIG_ESP_MAIN_TASK_STACK_SIZE=8192
CONFIG_BT_NIMBLE_HOST_TASK_STACK_SIZE=8192
CONFIG_NIMBLE_TASK_STACK_SIZE=8192
CONFIG_BT_NIMBLE_TASK_STACK_SIZE=8192

# ---- Brownout ----
# Level 5 (medium) instead of 7 (most sensitive) to prevent false restarts
# on USB power dips during recording
CONFIG_ESP_BROWNOUT_DET_LVL_SEL_5=y
CONFIG_ESP_BROWNOUT_DET_LVL=5
CONFIG_ESP32S3_BROWNOUT_DET_LVL_SEL_5=y
CONFIG_ESP32S3_BROWNOUT_DET_LVL=5
# disable the overly sensitive level 7
CONFIG_ESP_BROWNOUT_DET_LVL_SEL_7=n
CONFIG_ESP32S3_BROWNOUT_DET_LVL_SEL_7=n
```
